## conf/layer.conf
```bitbake
BBPATH .= ":${LAYERDIR}"
BBFILES += "${LAYERDIR}/recipes-*/*/*.bb \
            ${LAYERDIR}/recipes-*/*/*.bbappend"

BBFILE_COLLECTIONS += "meta-kiko"
BBFILE_PATTERN_meta-kiko = "^${LAYERDIR}/"
BBFILE_PRIORITY_meta-kiko = "6"

LAYERDEPENDS_meta-kiko = "core raspberrypi"
LAYERSERIES_COMPAT_meta-kiko = "kirkstone"
```
